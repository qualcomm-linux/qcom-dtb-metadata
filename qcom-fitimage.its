## qcom-next-fitimage.its
```
/dts-v1/;

/ {
	description = "Qualcomm FIT Image for DTBs";

	images {
		fdt-qcom-metadata.dtb {
			description = "metadata for multi-DTB selection";
			data = /incbin/("./qcom-metadata.dtb");
			type = "qcom_metadata";
		};
		fdt-qcm6490-idp.dtb {
			data = /incbin/("./arch/arm64/boot/dts/qcom/qcm6490-idp.dtb");
			type = "flat_dt";
		};
		fdt-qcs6490-rb3gen2.dtb {
			data = /incbin/("./arch/arm64/boot/dts/qcom/qcs6490-rb3gen2.dtb");
			type = "flat_dt";
		};
		fdt-qcs6490-rb3gen2-vision-mezzanine.dtb {
			data = /incbin/("./arch/arm64/boot/dts/qcom/qcs6490-rb3gen2-vision-mezzanine.dtb");
			type = "flat_dt";
		};
		fdt-qcs6490-rb3gen2-industrial-mezzanine.dtb {
			data = /incbin/("./arch/arm64/boot/dts/qcom/qcs6490-rb3gen2-industrial-mezzanine.dtb");
			type = "flat_dt";
		};
		fdt-qcs6490-rb3gen2-industrial-mezzanine-m2-cologne.dtbo {
			data = /incbin/("./arch/arm64/boot/dts/qcom/qcs6490-rb3gen2-industrial-mezzanine-m2-cologne.dtbo");
			type = "flat_dt";
		};
		fdt-lemans-evk.dtb {
			data = /incbin/("./arch/arm64/boot/dts/qcom/lemans-evk.dtb");
			type = "flat_dt";
		};
		fdt-lemans-evk-el2.dtb {
			data = /incbin/("./arch/arm64/boot/dts/qcom/lemans-evk-el2.dtb");
			type = "flat_dt";
		};
		fdt-qcs9100-ride.dtb {
			data = /incbin/("./arch/arm64/boot/dts/qcom/qcs9100-ride.dtb");
			type = "flat_dt";
		};
		fdt-qcs9100-ride-r3.dtb {
			data = /incbin/("./arch/arm64/boot/dts/qcom/qcs9100-ride-r3.dtb");
			type = "flat_dt";
		};
		fdt-qcs9100-ride-el2.dtb {
			data = /incbin/("./arch/arm64/boot/dts/qcom/qcs9100-ride-el2.dtb");
			type = "flat_dt";
		};
		fdt-qcs9100-ride-r3-el2.dtb {
			data = /incbin/("./arch/arm64/boot/dts/qcom/qcs9100-ride-r3-el2.dtb");
			type = "flat_dt";
		};
		fdt-qcs8300-ride.dtb {
			data = /incbin/("./arch/arm64/boot/dts/qcom/qcs8300-ride.dtb");
			type = "flat_dt";
		};
		fdt-qcs8300-ride-el2.dtb {
			data = /incbin/("./arch/arm64/boot/dts/qcom/qcs8300-ride-el2.dtb");
			type = "flat_dt";
		};
		fdt-monaco-evk.dtb {
			data = /incbin/("./arch/arm64/boot/dts/qcom/monaco-evk.dtb");
			type = "flat_dt";
		};
		fdt-monaco-evk-el2.dtb {
			data = /incbin/("./arch/arm64/boot/dts/qcom/monaco-evk-el2.dtb");
			type = "flat_dt";
		};
		fdt-qcs615-ride.dtb {
			data = /incbin/("./arch/arm64/boot/dts/qcom/qcs615-ride.dtb");
			type = "flat_dt";
		};
		fdt-qcs615-ride-el2.dtb {
			data = /incbin/("./arch/arm64/boot/dts/qcom/qcs615-ride-el2.dtb");
			type = "flat_dt";
		};
		fdt-talos-evk.dtb {
			data = /incbin/("./arch/arm64/boot/dts/qcom/talos-evk.dtb");
			type = "flat_dt";
		};
		fdt-talos-evk-lvds-auo,g133han01.dtb {
			data = /incbin/("./arch/arm64/boot/dts/qcom/talos-evk-lvds-auo,g133han01.dtb");
			type = "flat_dt";
		};
		fdt-sa8775p-ride.dtb {
			data = /incbin/("./arch/arm64/boot/dts/qcom/sa8775p-ride.dtb");
			type = "flat_dt";
		};
		fdt-sa8775p-ride-r3.dtb {
			data = /incbin/("./arch/arm64/boot/dts/qcom/sa8775p-ride-r3.dtb");
			type = "flat_dt";
		};
		fdt-hamoa-iot-evk.dtb {
			data = /incbin/("./arch/arm64/boot/dts/qcom/hamoa-iot-evk.dtb");
			type = "flat_dt";
		};
		fdt-hamoa-iot-evk-el2.dtb {
			data = /incbin/("./arch/arm64/boot/dts/qcom/hamoa-iot-evk-el2.dtb");
			type = "flat_dt";
		};
		fdt-purwa-iot-evk.dtb {
			data = /incbin/("./arch/arm64/boot/dts/qcom/purwa-iot-evk.dtb");
			type = "flat_dt";
		};
		fdt-purwa-iot-evk-el2.dtb {
			data = /incbin/("./arch/arm64/boot/dts/qcom/purwa-iot-evk-el2.dtb");
			type = "flat_dt";
		};
		fdt-glymur-crd.dtb {
			data = /incbin/("./arch/arm64/boot/dts/qcom/glymur-crd.dtb");
			type = "flat_dt";
		};
		fdt-lemans-evk-camx.dtbo {
			data = /incbin/("./arch/arm64/boot/dts/qcom/lemans-evk-camx.dtbo");
			type = "flat_dt";
		};
		fdt-lemans-camx-el2.dtb {
			data = /incbin/("./arch/arm64/boot/dts/qcom/lemans-camx-el2.dtb");
			type = "flat_dt";
		};
		fdt-monaco-evk-camx.dtbo {
			data = /incbin/("./arch/arm64/boot/dts/qcom/monaco-evk-camx.dtbo");
			type = "flat_dt";
		};
		fdt-monaco-camx-el2.dtb {
			data = /incbin/("./arch/arm64/boot/dts/qcom/monaco-camx-el2.dtb");
			type = "flat_dt";
		};
		fdt-qcs8300-ride-camx.dtbo {
			data = /incbin/("./arch/arm64/boot/dts/qcom/qcs8300-ride-camx.dtbo");
			type = "flat_dt";
		};
		fdt-sa8775p-ride-camx.dtbo {
			data = /incbin/("./arch/arm64/boot/dts/qcom/sa8775p-ride-camx.dtbo");
			type = "flat_dt";
		};
		fdt-lemans-el2.dtbo {
			data = /incbin/("./arch/arm64/boot/dts/qcom/lemans-el2.dtbo");
			type = "flat_dt";
		};
		fdt-monaco-el2.dtbo {
			data = /incbin/("./arch/arm64/boot/dts/qcom/monaco-el2.dtbo");
			type = "flat_dt";
		};
		fdt-talos-el2.dtbo {
			data = /incbin/("./arch/arm64/boot/dts/qcom/talos-el2.dtbo");
			type = "flat_dt";
		};
		fdt-lemans-camx-el2.dtbo {
			data = /incbin/("./arch/arm64/boot/dts/qcom/lemans-camx-el2.dtbo");
			type = "flat_dt";
		};
		fdt-hamoa-iot-evk-camera-imx577.dtbo {
			data = /incbin/("./arch/arm64/boot/dts/qcom/hamoa-iot-evk-camera-imx577.dtbo");
			type = "flat_dt";
		};
		fdt-monaco-camx-el2.dtbo {
			data = /incbin/("./arch/arm64/boot/dts/qcom/monaco-camx-el2.dtbo");
			type = "flat_dt";
		};
		fdt-x1-el2.dtbo {
			data = /incbin/("./arch/arm64/boot/dts/qcom/x1-el2.dtbo");
			type = "flat_dt";
		};
		fdt-lemans-evk-ifp-mezzanine.dtbo {
			data = /incbin/("./arch/arm64/boot/dts/qcom/lemans-evk-ifp-mezzanine.dtbo");
			type = "flat_dt";
		};
		fdt-monaco-evk-ifp-mezzanine.dtbo {
			data = /incbin/("./arch/arm64/boot/dts/qcom/monaco-evk-ifp-mezzanine.dtbo");
			type = "flat_dt";
		};
		fdt-lemans-evk-camera-csi1-imx577.dtbo {
			data = /incbin/("./arch/arm64/boot/dts/qcom/lemans-evk-camera-csi1-imx577.dtbo");
			type = "flat_dt";
		};
		fdt-monaco-evk-camera-imx577.dtbo {
			data = /incbin/("./arch/arm64/boot/dts/qcom/monaco-evk-camera-imx577.dtbo");
			type = "flat_dt";
		};
		fdt-hamoa-staging.dtbo {
			data = /incbin/("./arch/arm64/boot/dts/qcom/hamoa-staging.dtbo");
			type = "flat_dt";
		}; 
		fdt-hamoa-evk-camx.dtbo {
			data = /incbin/("./arch/arm64/boot/dts/qcom/hamoa-evk-camx.dtbo");
			type = "flat_dt";
		};
		fdt-purwa-evk-camx.dtbo {
			data = /incbin/("./arch/arm64/boot/dts/qcom/purwa-evk-camx.dtbo");
			type = "flat_dt";
		};
		fdt-shikra-cqm-evk.dtb {
			data = /incbin/("./arch/arm64/boot/dts/qcom/shikra-cqm-evk.dtb");
		};
		fdt-shikra-cqs-evk.dtb {
			data = /incbin/("./arch/arm64/boot/dts/qcom/shikra-cqs-evk.dtb");
		};
		fdt-shikra-iqs-evk.dtb {
			data = /incbin/("./arch/arm64/boot/dts/qcom/shikra-iqs-evk.dtb");
		};
		fdt-hamoa-camx-el2.dtbo {
			data = /incbin/("./arch/arm64/boot/dts/qcom/hamoa-camx-el2.dtbo");
			type = "flat_dt";
		};
		fdt-purwa-camx-el2.dtbo {
			data = /incbin/("./arch/arm64/boot/dts/qcom/purwa-camx-el2.dtbo");
			type = "flat_dt";
		};
		fdt-sm8750-mtp.dtb {
			data = /incbin/("./arch/arm64/boot/dts/qcom/sm8750-mtp.dtb");
			type = "flat_dt";
		};
		fdt-sm8750-qrd.dtb {
			data = /incbin/("./arch/arm64/boot/dts/qcom/sm8750-qrd.dtb");
			type = "flat_dt";
		};
		fdt-kaanapali-mtp.dtb {
			data = /incbin/("./arch/arm64/boot/dts/qcom/kaanapali-mtp.dtb");
			type = "flat_dt";
		};
		fdt-kaanapali-qrd.dtb {
			data = /incbin/("./arch/arm64/boot/dts/qcom/kaanapali-qrd.dtb");
			type = "flat_dt";
		};
	};

	configurations {
		conf-1 {
			compatible = "qcom,qcm6490-idp";
			fdt = "fdt-qcm6490-idp.dtb";
		};
		conf-2 {
			compatible = "qcom,qcs6490-iot";
			fdt = "fdt-qcs6490-rb3gen2.dtb";
		};
		conf-3 {
			compatible = "qcom,qcs6490-iot-subtype2";
			fdt = "fdt-qcs6490-rb3gen2-vision-mezzanine.dtb";
		};
		conf-4 {
			compatible = "qcom,qcs6490-iot-subtype9";
			fdt = "fdt-qcs6490-rb3gen2-industrial-mezzanine.dtb";
		};
		conf-5 {
			compatible = "qcom,qcs9075-iot";
			fdt = "fdt-lemans-evk.dtb", "fdt-lemans-evk-camera-csi1-imx577.dtbo";
		};
		conf-6 {
			compatible = "qcom,qcs9100-qam";
			fdt = "fdt-qcs9100-ride-r3.dtb";
		};
		conf-7 {
			compatible = "qcom,qcs9100-qam-r1.0";
			fdt = "fdt-qcs9100-ride.dtb";
		};
		conf-8 {
			compatible = "qcom,qcs8300-adp";
			fdt = "fdt-qcs8300-ride.dtb";
		};
		conf-9 {
			compatible = "qcom,qcs8275-iot";
			fdt = "fdt-monaco-evk.dtb", "fdt-monaco-evk-camera-imx577.dtbo";
		};
		conf-10 {
			compatible = "qcom,qcs615-adp";
			fdt = "fdt-qcs615-ride.dtb";
		};
		conf-11 {
			compatible = "qcom,sa8775p-qam";
			fdt = "fdt-sa8775p-ride-r3.dtb";
		};
		conf-12 {
			compatible = "qcom,sa8775p-qam-r1.0";
			fdt = "fdt-sa8775p-ride.dtb";
		};
		conf-13 {
			compatible = "qcom,hamoa-evk";
			fdt = "fdt-hamoa-iot-evk.dtb", "fdt-hamoa-iot-evk-camera-imx577.dtbo";
		};
		conf-14 {
			compatible = "qcom,qcs9075-iot-camx";
			fdt = "fdt-lemans-evk.dtb", "fdt-lemans-evk-camx.dtbo";
		};
		conf-15 {
			compatible = "qcom,qcs8275-iot-camx";
			fdt = "fdt-monaco-evk.dtb", "fdt-monaco-evk-camx.dtbo";
		};
		conf-16 {
			compatible = "qcom,qcs8300-adp-camx";
			fdt = "fdt-qcs8300-ride.dtb", "fdt-qcs8300-ride-camx.dtbo";
		};
		conf-17 {
			compatible = "qcom,sa8775p-qam-camx";
			fdt = "fdt-sa8775p-ride-r3.dtb", "fdt-sa8775p-ride-camx.dtbo";
		};
		conf-18 {
			compatible = "qcom,sa8775p-qam-r1.0-camx";
			fdt = "fdt-sa8775p-ride.dtb", "fdt-sa8775p-ride-camx.dtbo";
		};
		conf-19 {
			compatible = "qcom,qcs5430-iot";
			fdt = "fdt-qcs6490-rb3gen2.dtb";
		};
		conf-20 {
			compatible = "qcom,qcs5430-iot-subtype2";
			fdt = "fdt-qcs6490-rb3gen2-vision-mezzanine.dtb";
		};
		conf-21 {
			compatible = "qcom,qcs5430-iot-subtype9";
			fdt = "fdt-qcs6490-rb3gen2-industrial-mezzanine.dtb";
		};
		conf-22 {
			compatible = "qcom,qcs615-iot";
			fdt = "fdt-talos-evk.dtb";
		};
		conf-23 {
			compatible = "qcom,qcs615-iot-subtype6";
			fdt = "fdt-talos-evk-lvds-auo,g133han01.dtb";
		};
		conf-24 {
			compatible = "qcom,qcs9075-iot-el2kvm";
			fdt = "fdt-lemans-evk.dtb", "fdt-lemans-evk-camera-csi1-imx577.dtbo", "fdt-lemans-el2.dtbo";
		};
		conf-25 {
			compatible = "qcom,qcs9100-qam-el2kvm";
			fdt = "fdt-qcs9100-ride-r3-el2.dtb";
		};
		conf-26 {
			compatible = "qcom,qcs9100-qam-r1.0-el2kvm";
			fdt = "fdt-qcs9100-ride-el2.dtb";
		};
		conf-27 {
			compatible = "qcom,qcs9075-iot-camx-el2kvm";
			fdt = "fdt-lemans-camx-el2.dtb";
		};
		conf-28 {
			compatible = "qcom,purwa-evk";
			fdt = "fdt-purwa-iot-evk.dtb";
		};
		conf-29 {
			compatible = "qcom,sa8775p-qam-el2kvm";
			fdt = "fdt-sa8775p-ride-r3.dtb", "fdt-lemans-el2.dtbo";
		};
		conf-30 {
			compatible = "qcom,sa8775p-qam-r1.0-el2kvm";
			fdt = "fdt-sa8775p-ride.dtb", "fdt-lemans-el2.dtbo";
		};
		conf-31 {
			compatible = "qcom,sa8775p-qam-camx-el2kvm";
			fdt = "fdt-sa8775p-ride-r3.dtb", "fdt-sa8775p-ride-camx.dtbo", "fdt-lemans-el2.dtbo", "fdt-lemans-camx-el2.dtbo";
		};
		conf-32 {
			compatible = "qcom,sa8775p-qam-r1.0-camx-el2kvm";
			fdt = "fdt-sa8775p-ride.dtb", "fdt-sa8775p-ride-camx.dtbo", "fdt-lemans-el2.dtbo", "fdt-lemans-camx-el2.dtbo";
		};
		conf-33 {
			compatible = "qcom,qcs8300-adp-el2kvm";
			fdt = "fdt-qcs8300-ride-el2.dtb";
		};
		conf-34 {
			compatible = "qcom,qcs8275-iot-el2kvm";
			fdt = "fdt-monaco-evk.dtb", "fdt-monaco-evk-camera-imx577.dtbo", "fdt-monaco-el2.dtbo";
		};
		conf-35 {
			compatible = "qcom,qcs8275-iot-camx-el2kvm";
			fdt = "fdt-monaco-camx-el2.dtb";
		};
		conf-36 {
			compatible = "qcom,qcs8300-adp-camx-el2kvm";
			fdt = "fdt-qcs8300-ride.dtb", "fdt-qcs8300-ride-camx.dtbo", "fdt-monaco-el2.dtbo", "fdt-monaco-camx-el2.dtbo";
		};
		conf-37 {
			compatible = "qcom,glymur-crd";
			fdt = "fdt-glymur-crd.dtb";
		};
		conf-38 {
			compatible = "qcom,qcs615-adp-el2kvm";
			fdt = "fdt-qcs615-ride-el2.dtb";
		};
		conf-39 {
			compatible = "qcom,hamoa-evk-el2kvm";
			fdt = "fdt-hamoa-iot-evk.dtb", "fdt-hamoa-iot-evk-camera-imx577.dtbo", "fdt-x1-el2.dtbo";
		};
		conf-40 {
			compatible = "qcom,qcs9075-iot-subtype1";
			fdt = "fdt-lemans-evk.dtb", "fdt-lemans-evk-ifp-mezzanine.dtbo";
		};
		conf-41 {
			compatible = "qcom,qcs8275-iot-subtype3";
			fdt = "fdt-monaco-evk.dtb", "fdt-monaco-evk-ifp-mezzanine.dtbo";
		};
		conf-42 {
			compatible = "qcom,purwa-evk-el2kvm";
			fdt = "fdt-purwa-iot-evk-el2.dtb";
		};
		conf-43 {
			compatible = "qcom,hamoa-evk-camx";
			fdt = "fdt-hamoa-iot-evk.dtb", "fdt-hamoa-evk-camx.dtbo";
		};
		conf-44 {
			compatible = "qcom,purwa-evk-camx";
			fdt = "fdt-purwa-iot-evk.dtb", "fdt-purwa-evk-camx.dtbo";
		};
		conf-45 {
			compatible = "qcom,shikracqm-itp";
			fdt = "fdt-shikra-cqm-evk.dtb";
		};
		conf-46 {
			compatible = "qcom,shikracqs-itp";
			fdt = "fdt-shikra-cqs-evk.dtb";
		};
		conf-47 {
			compatible = "qcom,shikraiqs-itp";
			fdt = "fdt-shikra-iqs-evk.dtb";
		};
		conf-48 {
			compatible = "qcom,qcs6490-iot-subtype13";
			fdt = "fdt-qcs6490-rb3gen2-industrial-mezzanine.dtb", "fdt-qcs6490-rb3gen2-industrial-mezzanine-m2-cologne.dtbo";
		};
        conf-49 {
			compatible = "qcom,hamoa-evk-camx-el2kvm";
			fdt = "fdt-hamoa-iot-evk.dtb", "fdt-hamoa-evk-camx.dtbo", "fdt-x1-el2.dtbo", "fdt-hamoa-camx-el2.dtbo";
		};
		conf-50 {
			compatible = "qcom,purwa-evk-camx-el2kvm";
			fdt = "fdt-purwa-iot-evk.dtb", "fdt-purwa-evk-camx.dtbo", "fdt-x1-el2.dtbo", "fdt-purwa-camx-el2.dtbo";
		};
		conf-51 {
			compatible = "qcom,sm8750-mtp";
			fdt = "fdt-sm8750-mtp.dtb";
		};
		conf-52 {
			compatible = "qcom,sm8750-qrd";
			fdt = "fdt-sm8750-qrd.dtb";
		};
		conf-53 {
			compatible = "qcom,kaanapali-mtp";
			fdt = "fdt-kaanapali-mtp.dtb";
		};
		conf-54 {
			compatible = "qcom,kaanapali-qrd";
			fdt = "fdt-kaanapali-qrd.dtb";
		};
		conf-55 {
			compatible = "qcom,hamoa-evk-staging";
			fdt = "fdt-hamoa-iot-evk.dtb", "fdt-hamoa-iot-evk-camera-imx577.dtbo", "fdt-hamoa-staging.dtbo";
		};
		conf-56 {
			compatible = "qcom,hamoa-evk-el2kvm-staging";
			fdt = "fdt-hamoa-iot-evk.dtb", "fdt-hamoa-iot-evk-camera-imx577.dtbo", "fdt-x1-el2.dtbo", "fdt-hamoa-staging.dtbo";
		};
	};
};
```
